## arch/arm/configs/mapphone_edison_defconfig
```kconfig
CONFIG_CMDLINE="root=/dev/ram0 rw mem=1023M@0x80000000 console=null vram=10300K omapfb.vram=0:8256K,1:4K,2:2040K init=/init ip=off mmcparts=mmcblk1:p7(pds),p15(boot),p16(recovery),p17(cdrom),p18(misc),p19(cid),p20(kpanic),p21(system),p22(cache),p23(preinstall),p24(webtop),p25(userdata) mot_sst=1 androidboot.bootloader=0x0A72"
CONFIG_APANIC_PLABEL="mmcblk1p20"
CONFIG_MID_SAFE_MODE_HELPER=m
```

## arch/arm/configs/mapphone_solana_defconfig
```kconfig
CONFIG_MACH_MAPPHONE_SOLANA=y
CONFIG_CMDLINE="root=/dev/ram0 rw mem=512M@0x80000000 console=null vram=10300K omapfb.vram=0:8256K,1:4K,2:2040K init=/init ip=off mmcparts=mmcblk1:p7(pds),p15(boot),p16(recovery),p17(cdrom),p18(misc),p19(cid),p20(kpanic),p21(system),p22(cache),p23(preinstall),p24(userdata),p25(emstorage) mot_sst=1 androidboot.bootloader=0x0A64"
CONFIG_VIDEO_OMAP_DCE=y
# CONFIG_SECURITY_MIDDLEWARE_COMPONENT is not set
```

## drivers/misc/pnx6718_mux/Kconfig
```kconfig
menuconfig FEAT_TD_TS27010MUX
	bool "TD-SCDMA modem MUX Support"
	default n
	help
	  Say Y here to enable TD-SCDMA modem MUX support.
```

## drivers/misc/pnx6718_mux/ts27010mux_uart/Kconfig
```kconfig
#
# TS 27.010 configuration
#

menu "Motorola TS 27.010 Mux driver over UART for TD-SCDMA modem"

config FEAT_TD_TS27010MUX_UART
        tristate "Motorola TS 27.010 Mux driver over UART for TD-SCDMA modem"
        default n

endmenu
```

## drivers/misc/pnx6718_mux/ts27010mux_usb/Kconfig
```kconfig
#
# TS 27.010 configuration
#

menu "Motorola TS 27.010 Mux driver over USB for TD-SCDMA modem"

config FEAT_TD_TS27010MUX_USB
        tristate "Motorola TS 27.010 Mux driver over USB for TD-SCDMA modem"
        default n

endmenu
```

## drivers/misc/sec/Kconfig
```kconfig
#
# Sec configuration
#

menu "Motorola sec driver"

config SEC_DRIVER
	tristate "Motorola sec driver"

endmenu
```

## drivers/net/spi/Kconfig
```kconfig
menu "SPI net support for Qualcomm modem"

config SPI_QMI
	bool "SPI qmi support"
	default n

endmenu
```

## drivers/staging/motorola/Kconfig
```kconfig
#
# TTY over spi slave configuration
#

menu "TTY driver over OMAP4 SPI slave"

config TTY_SPI_SLAVE_MDM6600
	bool "tty over spi slave driver"
	default n

endmenu
```

## drivers/staging/ste-modem/Kconfig
```kconfig
config MID_SAFE_MODE_HELPER
	tristate "MID safe mode helper driver"
	help
	  Say Yes here if you want to support safe mode operation.
	  Safe mode is mandatory to avoid current leakage between host
	  and modem chipset.

#	depends on ARCH_OMAP3 || ARCH_OMAP4
```

## drivers/video/omap2/misc/Kconfig
```kconfig
menuconfig OMAP2_DSS_MANAGER
	tristate "OMAP2/3/4 DSS2 Manager"
	depends on OMAP2_DSS
```

## drivers/video/omap2/omaplfb/Kconfig
```kconfig
config OMAPLFB
        bool "In-kernel omaplfb: interface between display and kernel side PowerVR graphics driver"
        depends on OMAP2_DSS && DSSCOMP
	default y
	help
	  Support for in-kernel omaplfb. This is used by PVR kernel module.

config OMAPLFB_CLONE_VRAM_TO_TILER
        bool "Enable HDMI cloning from vram framebuffer to tiler buffer"
        default n
```
